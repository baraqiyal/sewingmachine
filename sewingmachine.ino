#define MAXRPM 60
#define JOG_SPEED 4000
#define WINDER_SPEED 600

#define PEDALINPUT A0

#define FORWARD_BUTTON 13 // orange 12 brown 13 green ground
#define BACK_BUTTON 12

#define WINDER_BUTTON 11

#define MAINMOTOR_PULSE 46
#define MAINMOTOR_DIR 45
#define MAINMOTOR_ENABLE 44

#define WINDER_PULSE 8
#define WINDER_DIR 9
#define WINDER_ENABLE 10

#define DEFAULT_READING 1023
#define SLOWEST_READING 852
#define FASTEST_READING 29

#define PULSES_PER_REVOLUTION 1600

const PROGMEM uint16_t ramp[] = {24000, 24000, 12000, 12000, 6000, 6000, 3000, 3000, 1529, 1524, 1518, 1512, 1506,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 1, 1};


void runmotors();
long mapwithbounds(long, long, long, long, long, long, long);
long cropnumber(long, long, long);

void setup()
{

  Serial.begin(9600);

  while (!Serial)
  {
    delay(100);
  }

  pinMode(MAINMOTOR_PULSE, OUTPUT);
  digitalWrite(MAINMOTOR_PULSE, HIGH);
  pinMode(MAINMOTOR_DIR, OUTPUT);
  digitalWrite(MAINMOTOR_DIR, LOW);
  pinMode(MAINMOTOR_ENABLE, OUTPUT);
  digitalWrite(MAINMOTOR_ENABLE, HIGH);

  pinMode(WINDER_PULSE, OUTPUT);
  digitalWrite(WINDER_PULSE, HIGH);
  pinMode(WINDER_DIR, OUTPUT);
  digitalWrite(WINDER_DIR, LOW);
  pinMode(WINDER_ENABLE, OUTPUT);
  digitalWrite(WINDER_ENABLE, HIGH);

  pinMode(LED_BUILTIN, OUTPUT);

  pinMode(PEDALINPUT, INPUT);

  pinMode(FORWARD_BUTTON, INPUT_PULLUP);
  pinMode(BACK_BUTTON, INPUT_PULLUP);

  pinMode(WINDER_BUTTON, INPUT_PULLUP);


}

void loop()
{
  int pedalValue, forwardButton, backwardButton, winderButton;
  boolean mainloop = false;

  delay(100);

  pedalValue = analogRead(PEDALINPUT); // range of 1023 - 29, 1023 = off 852 = slowest setting, 29 = fastest setting
  // Serial.println(pedalValue);
  if (pedalValue < SLOWEST_READING)
  {
    mainloop = true;
  }

  forwardButton = digitalRead(FORWARD_BUTTON);
  backwardButton = digitalRead(BACK_BUTTON);
  if (forwardButton == LOW || backwardButton == LOW)
    mainloop = true;

  winderButton = digitalRead(WINDER_BUTTON);
  if (winderButton == LOW)
    mainloop = true;

  if (mainloop)
    runmotors();

  mainloop = false;
}

void runmotors()
{

  int pedalValue = SLOWEST_READING + 1;
  unsigned long prevmicrosecond, currmicrosecond;
  int newpedalvalue;
  long acutalmicroseconddelay = 30000, minimumdelay;
  long numberoframpvalues, targetindex;
  int pulsecount = 0, currentindex = 1, rampdownposition;
  boolean rampdown = false;
  double rampdownindexincrement, currentrampdownindex = 1;
  long readPedalDelay = 10;
  unsigned int readPedalDelayPrevMillseconds, readPedalDelayCurrMillSeconds;
  short pedalreadingscount = 0;
  boolean pedalactivated = false;

  boolean runMainMotor = false;
  int forwardButton = digitalRead(FORWARD_BUTTON);
  int backwardButton = digitalRead(BACK_BUTTON);
  int winderButton = digitalRead(WINDER_BUTTON);
  boolean jogmotor = false;
  unsigned long JOGprevmicrosecond, JOGcurrmicrosecond;
  int JOGdelayMicrosecond = JOG_SPEED, JOGindex = 0;
  short WinderIndex = 0;
  unsigned long winderPrevMicrosecond, winderCurrMicrosecond;
  int WinderMicrosecondDelay = WINDER_SPEED;
  int totalpulses = 0;
  winderPrevMicrosecond = micros();
  winderCurrMicrosecond = winderPrevMicrosecond;

  JOGprevmicrosecond = micros();
  JOGcurrmicrosecond = JOGprevmicrosecond;

  minimumdelay = 1e6 / (((float)MAXRPM / 60) * (PULSES_PER_REVOLUTION));

  numberoframpvalues = (sizeof(ramp) / sizeof(ramp[0])) - 1;
  prevmicrosecond = micros();
  readPedalDelayPrevMillseconds = 0;
  int rampdowncurrentpos = 0;

  do
  {

    readPedalDelayCurrMillSeconds = millis();

    if (readPedalDelayCurrMillSeconds >= readPedalDelayPrevMillseconds + readPedalDelay)
    {
      readPedalDelayPrevMillseconds = readPedalDelayCurrMillSeconds;

      // read pedal every 100th of a second
      pedalValue = analogRead(PEDALINPUT); // range of 1023 - 29, 1023 = off 852 = slowest setting, 29 = fastest setting

      forwardButton = digitalRead(FORWARD_BUTTON);
      backwardButton = digitalRead(BACK_BUTTON);
      winderButton = digitalRead(WINDER_BUTTON);
    }

    if (!runMainMotor)
    {

      if (forwardButton == LOW || backwardButton == LOW)
      {
        jogmotor = true;
        digitalWrite(MAINMOTOR_DIR, (forwardButton == LOW) ? LOW : HIGH);
        digitalWrite(MAINMOTOR_ENABLE, LOW);
 
      }
      else
      {
        jogmotor = false;
        JOGindex = 0;
        JOGdelayMicrosecond = JOG_SPEED;
        digitalWrite(MAINMOTOR_ENABLE, HIGH);
      }

      if (pedalValue < SLOWEST_READING)
      {
        pedalactivated = true;
        runMainMotor = true;

        pulsecount = 0;
        currentindex = 1;
        currentrampdownindex = 1;
        rampdowncurrentpos = 0;
        rampdown = false;
        totalpulses = 0;

        digitalWrite(MAINMOTOR_ENABLE, LOW); // LOW = ENABLE
        digitalWrite(MAINMOTOR_DIR, LOW);    // LOW = CLOCKWISE
      }

      if (jogmotor)
      {
        JOGcurrmicrosecond = micros();
        if (JOGcurrmicrosecond >= JOGprevmicrosecond + JOGdelayMicrosecond)
        {

          JOGprevmicrosecond = JOGcurrmicrosecond;
          digitalWrite(MAINMOTOR_PULSE, !digitalRead(MAINMOTOR_PULSE)); // move the motor one pulse
        
          JOGindex += 3;
          JOGindex = min(JOGindex, numberoframpvalues);
        }
        runMainMotor = false;
      }
    }

    if (winderButton == LOW) // WINDER WINDER
    {

      winderCurrMicrosecond = micros();
      winderPrevMicrosecond = (winderCurrMicrosecond < winderPrevMicrosecond) ? 0 : winderPrevMicrosecond; // if int reset

      if (winderCurrMicrosecond >= winderPrevMicrosecond + WinderMicrosecondDelay + ramp[WinderIndex] * 4)
      {

        if (WinderIndex == 0)
        { // only enable the winder motor when we're using it.
          digitalWrite(WINDER_ENABLE, LOW);
        }
        winderPrevMicrosecond = winderCurrMicrosecond;
        digitalWrite(WINDER_PULSE, !digitalRead(WINDER_PULSE));

        WinderIndex += 2;
        WinderIndex = min(numberoframpvalues, WinderIndex);
      }
    }
    else
    {
      WinderIndex = 0;
      WinderMicrosecondDelay = WINDER_SPEED;
      digitalWrite(WINDER_ENABLE, HIGH);
    }
    if (runMainMotor)
    {
      currmicrosecond = micros();
      prevmicrosecond = (currmicrosecond < prevmicrosecond) ? 0 : prevmicrosecond; // check for int reset

      if (currmicrosecond >= prevmicrosecond + acutalmicroseconddelay)
      {
        prevmicrosecond = currmicrosecond;

        newpedalvalue = analogRead(PEDALINPUT);

        pedalValue = (abs(newpedalvalue - pedalValue) > 20) ? newpedalvalue : pedalValue; // filter out noise in the data line

        digitalWrite(MAINMOTOR_PULSE, !digitalRead(MAINMOTOR_PULSE)); // move the motor one pulse
        

        rampdowncurrentpos = (rampdown) ? rampdowncurrentpos + 1 : rampdowncurrentpos;

        totalpulses++;
        pulsecount = (pulsecount < PULSES_PER_REVOLUTION) ? pulsecount + 1 : 0;

        // map the pedal value to the ramp index
        targetindex = mapwithbounds(pedalValue, SLOWEST_READING, FASTEST_READING, 0, numberoframpvalues, numberoframpvalues, 0);

        // if user takes foot off pedal, start rampdown
        // end at home position
        if (targetindex < currentindex && !rampdown)
        {
          
          rampdownposition = PULSES_PER_REVOLUTION - pulsecount;
    

          rampdownindexincrement = ((double)currentindex / (double)rampdownposition)  ;

          rampdown = true;
          currentrampdownindex = currentindex;
        }
        if (rampdown)
        {
          currentrampdownindex -= rampdownindexincrement;
          currentindex = cropnumber((int)currentrampdownindex, numberoframpvalues, 0);
        }
        // if user pushing down on pedal, ramp up
        if (targetindex > currentindex)
        {
          currentindex = cropnumber(currentindex + 1, numberoframpvalues, 0);
          currentrampdownindex++;
          rampdown = false;
          rampdowncurrentpos = 0;
        }

        acutalmicroseconddelay = (rampdown) ? minimumdelay + ramp[currentindex] * 2 : minimumdelay + ramp[currentindex] * 5;



      }

      if (rampdowncurrentpos >= rampdownposition && rampdown)
      {
        runMainMotor = false;

        pedalValue = DEFAULT_READING;
        digitalWrite(MAINMOTOR_ENABLE, HIGH);
      }
    }
  } while (winderButton == LOW || runMainMotor || jogmotor);
}

inline long mapwithbounds(long x, long in_min, long in_max, long out_min, long out_max, long max_value, long min_value)
{
  long mappedvalue;

  mappedvalue = map(x, in_min, in_max, out_min, out_max);
  mappedvalue = cropnumber(mappedvalue, max_value, min_value);

  return (mappedvalue);
}

inline long cropnumber(long x, long max_value, long min_value)
{
  long croppedvalue;

  croppedvalue = min(x, max_value);
  croppedvalue = max(croppedvalue, min_value);

  return (croppedvalue);
}
